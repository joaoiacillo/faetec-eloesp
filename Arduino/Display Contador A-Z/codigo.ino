const int linhas[] = {7, 6, 5, 4, 3, 2, 1};
const int colunas[] = {13, 12, 11, 10, 9};

int i; // Linha
int j; // Coluna
int s; // Simbolo
int r;

const int symbols[][7] = {
	// Alfabeto A-Z
	{ 0xe, 0x11, 0x11, 0x1f, 0x11, 0x11, 0x11},
	{ 0x1e, 0x11, 0x11, 0x1e, 0x11, 0x11, 0x1e},
	{ 0x1f, 0x10, 0x10, 0x10, 0x10, 0x10, 0x1f},
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	{ 0x1f, 0x2, 0x2, 0x4, 0x8, 0x8, 0x1f},
};

/*** Configuration ***/

void setup()
{
	for (i = 0; i < 7; i++)
	{
		pinMode(linhas[i], OUTPUT);
		digitalWrite(linhas[i], LOW);
	}
	
	for (j = 0; j < 5; j++)
	{
		pinMode(colunas[j], OUTPUT);
		digitalWrite(colunas[j], HIGH);
	}
}

/*** Functions ***/

void turnOffLine()
{
	for (j = 0; j < 5; j++) digitalWrite(colunas[j], HIGH);
	digitalWrite(linhas[i], LOW);
}

/*** Program ***/

void loop()
{
	// Para cada simbolo
	for (s = 0; s < 26; s++)
	{
		for (r = 0; r < 20; r++)
		{
			// Para cada linha
			for (i = 0; i < 7; i++)
			{
				digitalWrite(linhas[i], HIGH);
			
				// Para cada coluna
				for (j = 0; j < 5; j++)
				{
					int bit = bitRead(symbols[s][i], 4 - j);
					digitalWrite(colunas[j], !bit);
				}
				
				delay(5);
				turnOffLine();
			}
		}
	}
}
	
	
	
	
	
	
	
	
	
	
	
	
	
	
	
	
	